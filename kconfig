## kconfig
```kconfig
choice
	prompt "Target architecture"
	default TARGET_X86

	config TARGET_X86
		bool "x86"

	config TARGET_X86_64
		bool "x86-64"

	config TARGET_CORTEX_M0
		bool "ARM Cortex-M0"

	config TARGET_CORTEX_M3
		bool "ARM Cortex-M3"

	config TARGET_CORTEX_M4
		bool "ARM Cortex-M4"
endchoice

config PLATFORM
	string
	default x86         if TARGET_X86
	default x86-64      if TARGET_X86_64
	default cortex-m0   if TARGET_CORTEX_M0
	default cortex-m3   if TARGET_CORTEX_M3
	default cortex-m4   if TARGET_CORTEX_M4

menu "Filesystem options"

config OVERRIDE_LENGTH
	bool "Override default filename length"
	default n

config FILENAME_LENGTH
	int "Maximum filename length"
	default 31
	depends on OVERRIDE_LENGTH

config FAT_SECTOR
	int "Sector size"
	default 9
	help
	  Size of a filesystem sector may be 512, 1024, 2048 or 4096 bytes,
	  default is 512. Size is configured as an exponent of the value.

config FAT_POOLS
	bool "Object pools"
	default n
	help
	  Build driver with statically allocated buffers.

config FAT_THREADS
	bool "Multithreading"
	default n
	help
	  Enable multithreading.

config FAT_TIME
	bool "Time functions"
	default n
	help
	  Build driver with time functions enabled.

config FAT_UNICODE
	bool "Unicode support"
	default y
	help
	  Enable support for Unicode characters.

config FAT_WRITE
	bool "Write support"
	default y
	help
	  Enable write functions.

endmenu

menu "Build options"

choice
	prompt "Optimization level"
	default OPTIMIZATIONS_DISABLED

	config OPTIMIZATIONS_DISABLED
		bool "None"

	config OPTIMIZATIONS_SIZE
		bool "Size"

	config OPTIMIZATIONS_FULL
		bool "Full"

	config OPTIMIZATIONS_DEBUG
		bool "Debug"
endchoice

config OPTIMIZATIONS
	string
	default "none" if OPTIMIZATIONS_DISABLED
	default "size" if OPTIMIZATIONS_SIZE
	default "full" if OPTIMIZATIONS_FULL
	default "debug" if OPTIMIZATIONS_DEBUG

config FPU
	bool "FPU"
	default y
	help
	  This enables Floating Point Unit.
	depends on TARGET_CORTEX_M4

endmenu

menu "Debug options"
	depends on TARGET_X86 || TARGET_X86_64

config DEBUG
	bool "Debug messages"
	default n

config DEBUG_LEVEL
	int "Debug level"
	default 0
	depends on DEBUG

config SHELL
	bool "Build shell example"
	default y
	depends on LIBSHELL

config MMI_STATUS
	bool "Interface status"
	default n
	depends on SHELL

endmenu

menu "Examples"

config LIBSHELL
	bool "Build shell library"
	default y

config SHELL_BUFFER
	int "Buffer size"
	default 512
	depends on LIBSHELL

endmenu
```
